/*
 *  File:		XXMLLexer.cpp
 *  Summary:	A class used to extract tokens from XML documents
 *  Written by:	Jesse Jones
 *
 *  Copyright © 1999-2001 Jesse Jones. 
 *	This code is distributed under the zlib/libpng license (see License.txt for details).  
 *
 *  Change History (most recent first):	
 *
 *		$Log: XXMLLexer.cpp,v $
 *		Revision 1.5  2001/04/27 04:39:22  jesjones
 *		Updated for the XTranscode changes and/or replaced ASSERTs with PRECONDITION.
 *		
 *		Revision 1.4  2001/03/06 07:33:47  jesjones
 *		Replaced size() with empty() where possible (std::list::size() may take linear time to execute).
 *		
 *		Revision 1.3  2000/12/10 04:12:36  jesjones
 *		Replaced int16_cast, uint32_cast, etc with numeric_cast.
 *		
 *		Revision 1.2  2000/11/10 04:47:11  jesjones
 *		1) Removed double CRs introduced during the initial checkin. 2) Changed the header comments to make it clearer that Whisper is using the zlib license agreement. 3) Added the Log keyword.
 */

#include <XWhisperHeader.h>
#include <XXMLLexer.h>

#include <XAutoPtr.h>
#include <XNumbers.h>
#include <XResource.h>
#include <XScanner.h>
#include <XStringUtils.h>
#include <XXMLParser.h> 

namespace Whisper {


// ===================================================================================
//	struct SCharRange
// ===================================================================================
struct SCharRange {
  wchar_t		start;
  wchar_t 	end;
};


// ===================================================================================
//	Character Tables
// ===================================================================================
const SCharRange kLetterChars[] = {		// these are from the expat source 
  { '_' },								
  { ':' },
  /* BaseChar */
  { 0x0041, 0x005a },
  { 0x0061, 0x007a },
  { 0x00c0, 0x00d6 },
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  { 0xac00, 0xd7a3 },
  /* Ideographic */
  { 0x4e00, 0x9fa5 },
  { 0x3007 },
  { 0x3021, 0x3029 },
};

const SCharRange kNameChars[] = {
  { '.' },
  { '-' },
  /* CombiningChar */
  { 0x0300, 0x0345 },
  { 0x0360, 0x0361 },
  { 0x0483, 0x0486 },
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  { 0x309a },
  /* Digit */
  { 0x0030, 0x0039 },
  { 0x0660, 0x0669 },
  { 0x06f0, 0x06f9 },
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  { 0x0f20, 0x0f29 },
  /* Extender */
  { 0xb7 },
  { 0x02d0 },
  { 0x02d1 },
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  { 0x30fc, 0x30fe },
};


// ===================================================================================
//	class XXMLLexer
// ===================================================================================

//---------------------------------------------------------------
//
// XXMLLexer::~XXMLLexer
//
//---------------------------------------------------------------
XXMLLexer::~XXMLLexer()
{
	delete mScanner;

	mParser = nil;
}


//---------------------------------------------------------------
//
// XXMLLexer::XXMLLexer
//
//---------------------------------------------------------------
XXMLLexer::XXMLLexer(XXMLParser* parser, XScanner* takeScanner, const XURI& uri, bool internal) : mURI(uri)
{
	PRECONDITION(parser != nil);
	PRECONDITION(takeScanner != nil);
	
	mParser = parser;
	mScanner = takeScanner;
	mInternal = internal;
	
	mExpandPEs = 0;
	mCurrentEnd = ULONG_MAX;		

	mScanner->ClearWhiteSpace();	
	mScanner->SetWhiteSpace(kTabChar);	
	mScanner->SetWhiteSpace(kLineFeedChar);	
	mScanner->SetWhiteSpace(kReturnChar);	
	mScanner->SetWhiteSpace(kSpaceChar);	
}


//---------------------------------------------------------------
//
// XXMLLexer::Reset
//
//---------------------------------------------------------------
void XXMLLexer::Reset()
{
	mTokens.clear();
	
	mScanner->Reset();
}


//---------------------------------------------------------------
//
// XXMLLexer::UpdateLanguage
//
//---------------------------------------------------------------
void XXMLLexer::UpdateLanguage(const std::wstring& newText)
{
	XScannerPos pos = mScanner->GetPosition();
	
	mScanner->SetText(newText);
	mScanner->SetPosition(pos);
}


//---------------------------------------------------------------
//
// XXMLLexer::ExpandInternalParameterReferences
//
//---------------------------------------------------------------
void XXMLLexer::ExpandInternalParameterReferences(bool expand)
{
	if (expand)
		mExpandPEs++;
	else
		mExpandPEs--;
}


//---------------------------------------------------------------
//
// XXMLLexer::AtEnd
//
//---------------------------------------------------------------
bool XXMLLexer::AtEnd() const
{
	bool atEnd = false;
	
	if (mScanner->AtEnd())
		if (mTokens.empty())
			atEnd = true;
	
	return atEnd;
}


//---------------------------------------------------------------
//
// XXMLLexer::ReadToken
//
//---------------------------------------------------------------
void XXMLLexer::ReadToken()
{
	mTokens.clear();
	
	this->DoReadTokens(ULONG_MAX);
	
	if (!mScanner->AtEnd())
		if (mTokens.empty())
			mScanner->Advance();
		else
			mScanner->Advance(numeric_cast<int32>(mTokens.back().length));

	if (mExpandPEs > 0 && !mTokens.empty()) {
		XScannerPos oldPos = mTokens.back().pos;	

		TokenNum token = mTokens.back().num;
		if (token == kPercentToken) {
			if (this->DoExpandPE()) {
				mScanner->SetPosition(oldPos);
				this->ReadToken();
			}
				
		} else if (token == kWhiteSpaceToken) {			// when expanding a PE whitespace is added to the replacement text
			if (mScanner->Peek() == '%') {				// this can cause problems in the parsers because we can wind up with two whitespace tokens in a row
				if (mScanner->Peek(1) > kSpaceChar) {	// so we use this ugly code to merge the tokens...					
					this->ReadToken();
					
					mScanner->SetPosition(oldPos);
					if (this->GetToken().num != kPercentToken)
						this->ReadToken();
				}
			}
		}
	}
}


//---------------------------------------------------------------
//
// XXMLLexer::ReadFixedToken
//
//---------------------------------------------------------------
void XXMLLexer::ReadFixedToken(uint32 maxChars)
{
	mTokens.clear();
	
	this->DoReadTokens(maxChars);
	ASSERT(mTokens.empty() || mTokens.back().length <= maxChars);
		
	if (!mScanner->AtEnd())
		if (mTokens.empty())
			mScanner->Advance();
		else
			mScanner->Advance(numeric_cast<int32>(mTokens.back().length));

	if (mExpandPEs > 0) {
		XScannerPos oldPos = mTokens.back().pos;	

		if (this->GetToken().num == kPercentToken) {
			if (this->DoExpandPE()) {
				mScanner->SetPosition(oldPos);
				this->ReadFixedToken(maxChars);
			}
			
		} else if (this->GetToken().num == kWhiteSpaceToken) {	// when expanding a PE whitespace is added to the replacement text
			if (mScanner->Peek() == '%') {						// this can cause problems in the parsers because we can wind up with two whitespace tokens in a row
				if (mScanner->Peek(1) > kSpaceChar) {			// so we use this ugly code to merge the tokens...					
					this->ReadToken();
					
					mScanner->SetPosition(oldPos);
					if (this->GetToken().num != kPercentToken)
						this->ReadToken();
				}
			}
		}
	}
}


//---------------------------------------------------------------
//
// XXMLLexer::GetText
//
// CW 5 won't inline this...
//
//---------------------------------------------------------------
std::wstring XXMLLexer::GetText(const SXMLToken& token) const					
{
	return mScanner->GetText().substr(token.pos.GetIndex(), token.length);
}


//---------------------------------------------------------------
//
// XXMLLexer::SkipToken
//
//---------------------------------------------------------------
void XXMLLexer::SkipToken(const SXMLToken& token)
{
	int32 delta = numeric_cast<int32>(mTokens.back().length - token.length);

	if (delta > 0)
		mScanner->Advance(-delta);
}


//---------------------------------------------------------------
//
// XXMLLexer::GetToken
//
//---------------------------------------------------------------
SXMLToken XXMLLexer::GetToken(uint32 index) const
{	
	SXMLToken token;
	
	if (!mTokens.empty())
		token = mTokens[mTokens.size() - index - 1];
	
	else {
		token.num    = kNoToken;
		token.pos    = mScanner->GetPosition();
		token.length = ULONG_MAX;
	}
	
	return token;
}


//---------------------------------------------------------------
//
// XXMLLexer::FindToken
//
//---------------------------------------------------------------
bool XXMLLexer::FindToken(TokenNum num, SXMLToken& token) const
{
	bool found = false;
	
	for (uint32 index = 0; index < mTokens.size() && !found; ++index) {
		const SXMLToken& candidate = mTokens[index];
		
		if (num == candidate.num) {
			token = candidate;
			found = true;
		}
	}
	
	return found;
}


//---------------------------------------------------------------
//
// XXMLLexer::IsLetter									[static]
//
// [85] Letter ::= BaseChar | Ideographic
//
// There are lot's of ways to handle this. I chose to use one of
// the simpler methods: a 65536 element lookup table. The only
// problem with this is the size of the table and the accompanying
// concern about thrashing the cache. The table size is of minor
// concern on OS's with decent VM (on the Mac the MSL in Pro4
// specializes vector<bool> so that the bits are packed into a
// byte so the table sizes are only 8K each which isn't too bad).
// Cache thrashing is independant of the table size: what matters
// is the amount of the table that actually gets used. For documents
// written in most of the European languages the number of elements
// used will be much less than 100 which won't affect the cache
// much even if vector<bool> isn't specialized. However documents
// written in some of the Asian languages could wind up using a
// *lot* of characters which could cause some cache thrashing.
//
//---------------------------------------------------------------
bool XXMLLexer::IsLetter(wchar_t ch)
{
	static std::vector<bool> letters;
	
	if (letters.size() == 0) {
		letters.resize(65536, false);
				
		for (uint32 i = 0; i < sizeof(kLetterChars)/sizeof(SCharRange); ++i) {
			letters[kLetterChars[i].start] = true;
			
			if (kLetterChars[i].end != 0) 
				for (uint32 n = kLetterChars[i].start + 1UL; n <= kLetterChars[i].end; ++n) 
					letters[n] = true;
		}
	}
			
	bool is = letters[ch];
	
	return is;
}


//---------------------------------------------------------------
//
// XXMLLexer::IsNameChar								[static]
//
// [4] NameChar ::= Letter | Digit | '.' | '-' | '_' | ':' | CombiningChar | Extender
//
//---------------------------------------------------------------
bool XXMLLexer::IsNameChar(wchar_t ch)
{
	static std::vector<bool> names;
	
	if (names.size() == 0) {
		names.resize(65536, false);
				
		for (uint32 i = 0; i < sizeof(kNameChars)/sizeof(SCharRange); ++i) {
			names[kNameChars[i].start] = true;
			
			if (kNameChars[i].end != 0) 
				for (uint32 n = kNameChars[i].start + 1UL; n <= kNameChars[i].end; ++n) 
					names[n] = true;
		}
	}
			
	bool is = names[ch] || IsLetter(ch);
	
	return is;
}


//---------------------------------------------------------------
//
// XXMLLexer::IsChar									[static]
//
// [2] Char ::= #x9 | #xA | #xD | [#x20-#D7FF] | [#xE000-#xFFFD] | [#x10000-#x10FFFF]
//
//---------------------------------------------------------------
bool XXMLLexer::IsChar(wchar_t ch)
{			
	bool is = ch == 0x9 || ch == 0xA || ch == 0xD || 
			  (ch >=    0x20 && ch <=   0xD7FF) ||
			  (ch >=  0xE000 && ch <=   0xFFFD);
			  
	if (!is && ch >= 0xD800 && ch <= 0x0DFFF) {
		uint32 a = 0xD800;
		uint32 b = (0x00FFFF >> 10) + 0xD800;
		uint32 n = (ch >> 10) + 0xD800UL;
		is = n >= a && n <= b;
		
		if (!is) {
			a = 0xDC00;
			b = (0x00FFFF & 0x3FF) + 0xDC00;
			n = (ch & 0x3FF) + 0xDC00UL;
			is = n >= a && n <= b;
		}
	}
	
	return is;
}

#if __MWERKS__
#pragma mark Ê
#endif

//---------------------------------------------------------------
//
// XXMLLexer::DoExpandPE
//
// Parameter references are hard to handle gracefully because they
// can appear *anywhere* in the DTD. It's possible to deal with
// them within the parser code, but this really clutters the code.
// To avoid this we handle them within the lexer (which creates
// some ugly coupling with XXMLReader).
//
//---------------------------------------------------------------
bool XXMLLexer::DoExpandPE()
{
	PRECONDITION(mExpandPEs > 0);
	
	std::vector<SXMLToken> oldTokens = mTokens;
	XScannerPos oldPos = mScanner->GetPosition();

	// '%'
	ASSERT(mTokens.back().num == kPercentToken);
	uint32 index = mTokens.back().pos.GetIndex();	
	this->ReadToken();
	
	// Name
	bool expanded = false;
	SXMLToken token = this->GetToken();
	std::wstring name = this->GetText(token);	
	if (token.num == kAlphaNumToken && (XXMLLexer::IsLetter(name[0]) || name[0] == '_' || name[0] == ':')) {
		this->ReadToken();
		
		// ';'
		token = this->GetToken();
		if (token.num == kSemiColonToken) {
			if (mInternal)
				XXMLException::Throw(this, "Parameter entities can only be referenced inside markup within the external DTD.");
		
			// Find the replacement text
			const XXMLParser::SEntity& entity = mParser->GetParameterEntity(name);
			ASSERT(entity.id.dataType.length() == 0);			// parameter entities cannot be unparsed
			
			std::wstring replacement;
			if (entity.internal) {
				replacement = entity.text;
				
			} else {
				XAutoPtr<XResource> data(entity.Load(mURI));
				if (data.Get() == nil)
					XXMLException::Throw(this, "Couldn't find the external parameter entity named: '#1'",  name);
			
				XAutoPtr<XXMLLexer> temp(mParser->CreateLexer(*data, false));		// $$ yuck
				replacement = temp->GetScanner()->GetText();
			}
			
			// Check for proper nesting
			int32 count1 = std::count(replacement.begin(), replacement.end(), '<');	// VC: Proper PE Nesting
			int32 count2 = std::count(replacement.begin(), replacement.end(), '>');	// $$ may not be sufficient...
			if (count1 != count2)
				XXMLException::Throw(this, "'#1' has mismatched '<' and '>'.", name);	

			count1 = std::count(replacement.begin(), replacement.end(), '(');
			count2 = std::count(replacement.begin(), replacement.end(), ')');
			if (count1 != count2)
				XXMLException::Throw(this, "'#1' has mismatched '(' and ')'.", name);	

			// Replace the reference with the replacement text
			if (mCurrentEntity.length() == 0 || index >= mCurrentEnd) {
				mCurrentEntity = name;
				mCurrentEnd = index + replacement.length() + 3;
				
			} else if (mCurrentEntity == name)								// WFC: No Recursion
				XXMLException::Throw(this, "'#1' has a recursive definition.", name);	
			
			else if (mCurrentEnd < ULONG_MAX)
				mCurrentEnd += replacement.length() + 2;

			mScanner->GetText().replace(index, name.length() + 2, L" " + replacement + L" ");	// included as PE (this shouldn't be too inefficient since it can only happen inside the external DTD which will almost never be huge)

			expanded = true;
		}
	}
		
	if (!expanded) {
		mTokens = oldTokens;
		mScanner->SetPosition(oldPos);
	}
	
	return expanded;
}


//---------------------------------------------------------------
//
// XXMLLexer::DoReadTokens
//
// $$ This is the primary bottle neck for the XML parser. When
// $$ parsing the content of a ten thousand line XML file 30% of 
// $$ the time was spent inside this function (the next largest
// $$ bottle neck was XMemoryHeap::Deallocate at 7.5% which could
// $$ probably be improved with a better allocator (I was using
// $$ XSimpleAllocator which starts to perform poorly as the
// $$ operator new heap fragments)).
//
//---------------------------------------------------------------
void XXMLLexer::DoReadTokens(uint32 maxChars)
{
	PRECONDITION(maxChars > 0);
	
	XScannerPos pos = mScanner->GetPosition();
	
	wchar_t ch;
	int32 index;
	uint32 count;
	
	wchar_t ch0 = mScanner->Peek(0);
	wchar_t ch1 = maxChars >= 2 ? mScanner->Peek(1) : L'\0';
	wchar_t ch2 = maxChars >= 3 ? mScanner->Peek(2) : L'\0';

	std::wstring text(1, ch0);

	switch (ch0) {
		case '<':
		case '#':
			{
				wchar_t ch3 = maxChars >= 4 ? mScanner->Peek(3) : L'\0';
				wchar_t ch4 = maxChars >= 5 ? mScanner->Peek(4) : L'\0';
				wchar_t ch5 = maxChars >= 6 ? mScanner->Peek(5) : L'\0';
				wchar_t ch6 = maxChars >= 7 ? mScanner->Peek(6) : L'\0';
				wchar_t ch7 = maxChars >= 8 ? mScanner->Peek(7) : L'\0';
				wchar_t ch8 = maxChars >= 9 ? mScanner->Peek(8) : L'\0';
				wchar_t ch9 = maxChars >= 10 ? mScanner->Peek(9) : L'\0';
	
				if (ch0 == '<') {
					mTokens.push_back(SXMLToken(kCharToken, pos, 1));
					mTokens.push_back(SXMLToken(kLessToken, pos, 1));
					
					if (maxChars > 1) {
						if (ch1 == '/') {
							mTokens.push_back(SXMLToken(kEndTagToken, pos, 2));
							
						} else if (ch1 == '?') {
							mTokens.push_back(SXMLToken(kPIStartToken, pos, 2));
							if (ch2 == 'x' && ch3 == 'm' && ch4 == 'l')
								mTokens.push_back(SXMLToken(kXMLTagToken, pos, 5));
						
						} else if (ch1 == '!') {
							if (ch2 == '[') {
								mTokens.push_back(SXMLToken(kDataStartToken, pos, 3));
								if (ch3 == 'C' && ch4 == 'D' && ch5 == 'A' && ch6 == 'T' && ch7 == 'A' && ch8 == '[')
									mTokens.push_back(SXMLToken(kCDSectTagToken, pos, 9));			
							
							} else if (ch2 == '-' && ch3 == '-')
								mTokens.push_back(SXMLToken(kCommentStartToken, pos, 4));
			
							else if (ch2 == 'A' && ch3 == 'T' && ch4 == 'T' && ch5 == 'L' && ch6 == 'I' && ch7 == 'S' && ch8 == 'T')
								mTokens.push_back(SXMLToken(kAttListTagToken, pos, 9));
								
							else if (ch2 == 'D' && ch3 == 'O' && ch4 == 'C' && ch5 == 'T' && ch6 == 'Y' && ch7 == 'P' && ch8 == 'E')
								mTokens.push_back(SXMLToken(kDocTypeTagToken, pos, 9));
								
							else if (ch2 == 'E') {
								if (ch3 == 'N' && ch4 == 'T' && ch5 == 'I' && ch6 == 'T' && ch7 == 'Y')
									mTokens.push_back(SXMLToken(kEntityTagToken, pos, 8));
								else if (ch3 == 'L' && ch4 == 'E' && ch5 == 'M' && ch6 == 'E' && ch7 == 'N' && ch8 == 'T')
									mTokens.push_back(SXMLToken(kElementTagToken, pos, 9));
			
							} else if (ch2 == 'N' && ch3 == 'O' && ch4 == 'T' && ch5 == 'A' && ch6 == 'T' && ch7 == 'I' && ch8 == 'O' && ch9 == 'N')
								mTokens.push_back(SXMLToken(kNotationTagToken, pos, 10));
						}
					}
				
				} else {
					mTokens.push_back(SXMLToken(kCharToken, pos, 1));
					mTokens.push_back(SXMLToken(kPoundToken, pos, 1));
					
					if (maxChars > 1) {
						if (ch1 == 'F' && ch2 == 'I' && ch3 == 'X' && ch4 == 'E' && ch5 == 'D')
							mTokens.push_back(SXMLToken(kFixedToken, pos, 6));
			
						else if (ch1 == 'I' && ch2 == 'M' && ch3 == 'P' && ch4 == 'L' && ch5 == 'I' && ch6 == 'E' && ch7 == 'D')
							mTokens.push_back(SXMLToken(kImpliedToken, pos, 8));
			
						else if (ch1 == 'P' && ch2 == 'C' && ch3 == 'D' && ch4 == 'A' && ch5 == 'T' && ch6 == 'A')
							mTokens.push_back(SXMLToken(kPCDataToken, pos, 7));
			
						else if (ch1 == 'R' && ch2 == 'E' && ch3 == 'Q' && ch4 == 'U' && ch5 == 'I' && ch6 == 'R' && ch7 == 'E' && ch8 == 'D')
							mTokens.push_back(SXMLToken(kRequiredToken, pos, 9));
					}
				}
			}
			break;

		case '>':
			mTokens.push_back(SXMLToken(kCharToken, pos, 1));
			mTokens.push_back(SXMLToken(kGreaterToken, pos, 1));
			break;
		
		case '/':
			mTokens.push_back(SXMLToken(kCharToken, pos, 1));
			if (ch1 == '>')
				mTokens.push_back(SXMLToken(kEmptyTagToken, pos, 2));
			break;
		
		case '?':
			mTokens.push_back(SXMLToken(kCharToken, pos, 1));
			mTokens.push_back(SXMLToken(kQuestionToken, pos, 1));
			if (ch1 == '>')
				mTokens.push_back(SXMLToken(kPIEndToken, pos, 2));
			break;
		
		case '%':
			mTokens.push_back(SXMLToken(kCharToken, pos, 1));
			mTokens.push_back(SXMLToken(kPercentToken, pos, 1));
			break;
		
		case '&':
			mTokens.push_back(SXMLToken(kCharToken, pos, 1));
			mTokens.push_back(SXMLToken(kAmpersandToken, pos, 1));
			break;
		
		case '-':
			mTokens.push_back(SXMLToken(kCharToken, pos, 1));
			if (ch1 == '-' && ch2 == '>')
				mTokens.push_back(SXMLToken(kCommentEndToken, pos, 3));
			break;
		
		case '+':
			mTokens.push_back(SXMLToken(kCharToken, pos, 1));
			mTokens.push_back(SXMLToken(kPlusToken, pos, 1));
			break;
		
		case '*':
			mTokens.push_back(SXMLToken(kCharToken, pos, 1));
			mTokens.push_back(SXMLToken(kStarToken, pos, 1));
			break;
		
		case '|':
			mTokens.push_back(SXMLToken(kCharToken, pos, 1));
			mTokens.push_back(SXMLToken(kBarToken, pos, 1));
			break;
		
		case '\'':
			mTokens.push_back(SXMLToken(kCharToken, pos, 1));
			mTokens.push_back(SXMLToken(kSingleQuoteToken, pos, 1));
			break;
		
		case '"':
			mTokens.push_back(SXMLToken(kCharToken, pos, 1));
			mTokens.push_back(SXMLToken(kDoubleQuoteToken, pos, 1));
			break;
		
		case ',':
			mTokens.push_back(SXMLToken(kCharToken, pos, 1));
			mTokens.push_back(SXMLToken(kCommaToken, pos, 1));
			break;
		
		case ';':
			mTokens.push_back(SXMLToken(kCharToken, pos, 1));
			mTokens.push_back(SXMLToken(kSemiColonToken, pos, 1));
			break;
		
		case ')':
			mTokens.push_back(SXMLToken(kCharToken, pos, 1));
			mTokens.push_back(SXMLToken(kRightParensToken, pos, 1));
			break;
		
		case '(':
			mTokens.push_back(SXMLToken(kCharToken, pos, 1));
			mTokens.push_back(SXMLToken(kLeftParensToken, pos, 1));
			break;
		
		case ']':
			mTokens.push_back(SXMLToken(kCharToken, pos, 1));
			mTokens.push_back(SXMLToken(kRightBracketToken, pos, 1));
			if (ch1 == ']' && ch2 == '>')
				mTokens.push_back(SXMLToken(kDataEndToken, pos, 3));
			break;
		
		case '[':
			mTokens.push_back(SXMLToken(kCharToken, pos, 1));
			mTokens.push_back(SXMLToken(kLeftBracketToken, pos, 1));
			break;
		
		case '=':
			mTokens.push_back(SXMLToken(kCharToken, pos, 1));
			
			if (maxChars > 1) {
				count = 1;
				
				index = 1;
				ch = mScanner->Peek(index);
				while (ch == kSpaceChar || ch == kTabChar || ch == kReturnChar || ch == kLineFeedChar) {
					++count;
					ch = mScanner->Peek(++index);
				}
				
				mTokens.push_back(SXMLToken(kEqualToken, pos, count));
			}
			break;

		case kSpaceChar:
		case kTabChar:
		case kReturnChar:
		case kLineFeedChar:
			mTokens.push_back(SXMLToken(kCharToken, pos, 1));
			
			if (maxChars > 1) {
				count = 1;
				
				index = 1;
				ch = mScanner->Peek(index);
				while (ch == kSpaceChar || ch == kTabChar || ch == kReturnChar || ch == kLineFeedChar) {
					++count;
					ch = mScanner->Peek(++index);
				}
				
				mTokens.push_back(SXMLToken(kWhiteSpaceToken, pos, count));
				
				if (ch == '=') {
					++count;
					ch = mScanner->Peek(++index);
					while (ch == kSpaceChar || ch == kTabChar || ch == kReturnChar || ch == kLineFeedChar) {
						++count;
						ch = mScanner->Peek(++index);
					}
	
					mTokens.push_back(SXMLToken(kEqualToken, pos, count));
				}
			}
			break;

		default:
			if (IsChar(ch0))
				mTokens.push_back(SXMLToken(kCharToken, pos, 1));
	}		

	// kAlphaNumToken
	if (maxChars == ULONG_MAX) {		// this is a bit weird, but we don't really want to match a fixed length name if the following characters are also valid name characters...
		index = 0;
		count = 0;
	
		ch = ch0;
		while (IsNameChar(ch)) {
			++count;
			ch = mScanner->Peek(++index);
		}
		
		if (count > 0)
			if (mTokens.empty() || count >= mTokens.back().length)
				mTokens.push_back(SXMLToken(kAlphaNumToken, pos, count));
	}
}


}	// namespace Whisper

