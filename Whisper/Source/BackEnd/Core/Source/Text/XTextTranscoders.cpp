/*
 *  File:		XTextTranscoders.cpp
 *  Summary:	Classes used to convert to and from Unicode.
 *  Written by:	Jesse Jones
 *
 *  Copyright © 1999-2001 Jesse Jones. 
 *	This code is distributed under the zlib/libpng license (see License.txt for details).  
 *
 *  Change History (most recent first):	
 *
 *		$Log: XTextTranscoders.cpp,v $
 *		Revision 1.5  2001/04/27 04:37:09  jesjones
 *		Updated for the XTranscode changes and/or replaced ASSERTs with PRECONDITION.
 *		
 *		Revision 1.4  2001/04/13 08:04:16  jesjones
 *		Ported to CarbonLib 1.3b2
 *		
 *		Revision 1.3  2000/12/10 04:12:25  jesjones
 *		Replaced int16_cast, uint32_cast, etc with numeric_cast.
 *		
 *		Revision 1.2  2000/11/09 12:55:29  jesjones
 *		1) Removed double CRs introduced during the initial checkin. 2) Changed the header comments to make it clearer that Whisper is using the zlib license agreement. 3) Added the Log keyword.
 *		
 *		 <5>	 3/22/00	JDJ		Added XEUCJPTranscoder and XShiftJISTranscoder (Mac only).
 *		 <4>	 1/26/00	JDJ		Added a unit test.
 *		 <3>	 5/03/99	JDJ		XUTF8Transcoder will do a proper conversion if OS support is missing.
 *		 <2>	 4/19/99	JDJ		No longer calls CreateTextEncoding without checking for TEC.
 *		 <1>	 1/25/99	JDJ		Created
 */

#include <XWhisperHeader.h>
#include <XTextTranscoders.h>		

#include <cvtutf.h>
#include <XExceptions.h>
#include <XNumbers.h>
#include <XStringUtils.h>

#if MAC	
	#include <MSystemInfo.h>
#endif

namespace Whisper {


//-----------------------------------
//	Tables
//
#if WIN
const wchar_t kMacToUnicode[256] = {
	0x0000, 0x0001, 0x0002, 0x0003, 0x0004, 0x0005, 0x0006, 0x0007, 0x0008, 0x0009, 0x000A, 0x000B, 0x000C, 0x000D, 0x000E, 0x000F, 
	0x0010, 0x0011, 0x0012, 0x0013, 0x0014, 0x0015, 0x0016, 0x0017, 0x0018, 0x0019, 0x001A, 0x001B, 0x001C, 0x001D, 0x001E, 0x001F, 
	0x0020, 0x0021, 0x0022, 0x0023, 0x0024, 0x0025, 0x0026, 0x0027, 0x0028, 0x0029, 0x002A, 0x002B, 0x002C, 0x002D, 0x002E, 0x002F, 
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	0xF8FF, 0x00D2, 0x00DA, 0x00DB, 0x00D9, 0x0131, 0x02C6, 0x02DC, 0x00AF, 0x02D8, 0x02D9, 0x02DA, 0x00B8, 0x02DD, 0x02DB, 0x02C7
};

struct SCharCode {
	uint8 	code;
	wchar_t	unicode;
	
		bool operator==(const SCharCode& rhs) const	{return unicode == rhs.unicode;}
		bool operator<(const SCharCode& rhs) const	{return unicode < rhs.unicode;}
};

const SCharCode kUnicodeToMac[256] = {
	{0x00, 0x0000}, {0x01, 0x0001}, {0x02, 0x0002}, {0x03, 0x0003}, {0x04, 0x0004}, {0x05, 0x0005}, {0x06, 0x0006}, {0x07, 0x0007}, 
	{0x08, 0x0008}, {0x09, 0x0009}, {0x0A, 0x000A}, {0x0B, 0x000B}, {0x0C, 0x000C}, {0x0D, 0x000D}, {0x0E, 0x000E}, {0x0F, 0x000F}, 
	{0x10, 0x0010}, {0x11, 0x0011}, {0x12, 0x0012}, {0x13, 0x0013}, {0x14, 0x0014}, {0x15, 0x0015}, {0x16, 0x0016}, {0x17, 0x0017}, 
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	{0xC5, 0x2248}, {0xAD, 0x2260}, {0xB2, 0x2264}, {0xB3, 0x2265}, {0xD7, 0x25CA}, {0xF0, 0xF8FF}, {0xDE, 0xFB01}, {0xDF, 0xFB02}
};
#endif	// WIN


//-----------------------------------
//	Constants
//
#if MAC
	const OSError kNoTranslation     = kTECUnmappableElementErr;
	const OSError kPartialConversion = kTECPartialCharErr;
	const OSError kBufferExhausted   = kTECOutputBufferFullStatus;
#elif WIN
	const OSError kNoTranslation     = ERROR_NO_UNICODE_TRANSLATION;
	const OSError kPartialConversion = ERROR_INVALID_PARAMETER;
	const OSError kBufferExhausted   = ERROR_INSUFFICIENT_BUFFER;
#endif


// ===================================================================================
//	Internal Functions
// ===================================================================================

//---------------------------------------------------------------
//
// MyCreateTextEncoding
//
//---------------------------------------------------------------
#if MAC
static TextEncoding MyCreateTextEncoding(TextEncodingBase base, TextEncodingVariant variant, TextEncodingFormat format)
{
	TextEncoding encoding = 0;		// encoding is only used when the TEC is present
	
	if (MSystemInfo::HasTextEncodingConverter())
		encoding = ::CreateTextEncoding(base, variant, format);
		
	return encoding;
}
#endif

#if __MWERKS__
#pragma mark -
#endif

// ===================================================================================
//	class XNaiveTranscoder
// ===================================================================================

//---------------------------------------------------------------
//
// XNaiveTranscoder::~XNaiveTranscoder
//
//---------------------------------------------------------------
XNaiveTranscoder::~XNaiveTranscoder()
{
}


//---------------------------------------------------------------
//
// XNaiveTranscoder::XNaiveTranscoder
//
//---------------------------------------------------------------
XNaiveTranscoder::XNaiveTranscoder(bool useDecomposedCharacters) : 
#if MAC
	XTextTranscoder(MyCreateTextEncoding(kTextEncodingUS_ASCII, (uint32) (useDecomposedCharacters ? kUnicodeCanonicalDecompVariant : kTextEncodingDefaultVariant), kTextEncodingDefaultFormat), useDecomposedCharacters)
#elif WIN
	XTextTranscoder(CP_ACP, useDecomposedCharacters)
#endif
{
	mUseOS = false;
	
	mEncoding = L"naive";
}


//---------------------------------------------------------------
//
// XNaiveTranscoder::Clone
//
//---------------------------------------------------------------
XNaiveTranscoder* XNaiveTranscoder::Clone() const
{
	return new XNaiveTranscoder;
}

#if __MWERKS__
#pragma mark -
#endif

// ===================================================================================
//	class XASCIITranscoder
// ===================================================================================

//---------------------------------------------------------------
//
// XASCIITranscoder::~XASCIITranscoder
//
//---------------------------------------------------------------
XASCIITranscoder::~XASCIITranscoder()
{
}


//---------------------------------------------------------------
//
// XASCIITranscoder::XASCIITranscoder	
//
//---------------------------------------------------------------
XASCIITranscoder::XASCIITranscoder(bool useDecomposedCharacters) : 
#if MAC
	XTextTranscoder(MyCreateTextEncoding(kTextEncodingUS_ASCII, (uint32) (useDecomposedCharacters ? kUnicodeCanonicalDecompVariant : kTextEncodingDefaultVariant), kTextEncodingDefaultFormat), useDecomposedCharacters)
#elif WIN
	XTextTranscoder(CP_ACP, useDecomposedCharacters)
#endif
{
	mEncoding = L"iso646-us";
}

//---------------------------------------------------------------
//
// XASCIITranscoder::Clone
//
//---------------------------------------------------------------
XASCIITranscoder* XASCIITranscoder::Clone() const
{
	return new XASCIITranscoder;
}


//---------------------------------------------------------------
//
// XASCIITranscoder::ConvertFromUTF16
//
//---------------------------------------------------------------
#if WIN
uint32 XASCIITranscoder::ConvertFromUTF16(const wchar_t* src, uint32 srcBytes, char* dst, uint32 dstBytes)
{
	PRECONDITION(src != nil);
	PRECONDITION(dst != nil);
			
	uint32 charBytes = charBytes = Inherited::ConvertFromUTF16(src, srcBytes, dst, dstBytes);
		
	// WideCharToMultiByte doesn't support conversion to standard
	// US-ASCII so we convert using the Windows ANSI code page
	// (which is equivalent to US ASCII for the first 128 characters)
	// and then check to see that no eight bit characters were created).
	for (uint32 index = 0; index < charBytes; ++index) {
		if (dst[index] > 127 || dst[index] < 0) {			// handle unsigned and signed characters...
			if (mFromUTF16Flags & MB_ERR_INVALID_CHARS) 
				ThrowErr(ERROR_NO_UNICODE_TRANSLATION);	
			else
				dst[index] = '?';
		}
	}

	return charBytes;
}
#endif

#if __MWERKS__
#pragma mark -
#endif

// ===================================================================================
//	class XMacRomanTranscoder
// ===================================================================================

//---------------------------------------------------------------
//
// XMacRomanTranscoder::~XMacRomanTranscoder
//
//---------------------------------------------------------------
XMacRomanTranscoder::~XMacRomanTranscoder()
{
}


//---------------------------------------------------------------
//
// XMacRomanTranscoder::XMacRomanTranscoder
//
//---------------------------------------------------------------
XMacRomanTranscoder::XMacRomanTranscoder(bool useDecomposedCharacters) : 
#if MAC
	XTextTranscoder(MyCreateTextEncoding(kTextEncodingMacRoman, (uint32) (useDecomposedCharacters ? kUnicodeCanonicalDecompVariant : kTextEncodingDefaultVariant), kTextEncodingDefaultFormat), useDecomposedCharacters)
#elif WIN
	XTextTranscoder(CP_MACCP, useDecomposedCharacters)		
#endif
{
	mEncoding = L"mac-roman";

#if MAC
	mToUTF16Flags   |= kUnicodeLooseMappingsMask;	
	mFromUTF16Flags |= kUnicodeLooseMappingsMask;
	
#elif WIN
	CPINFO info;
	int32 succeeded = ::GetCPInfo(CP_MACCP, &info);
	mHasMacCodePage = succeeded != 0;					// Win 98 doesn't usually have the Mac code page installed...
#endif
}


//---------------------------------------------------------------
//
// XMacRomanTranscoder::Clone
//
//---------------------------------------------------------------
XMacRomanTranscoder* XMacRomanTranscoder::Clone() const
{
	return new XMacRomanTranscoder;
}


//---------------------------------------------------------------
//
// XMacRomanTranscoder::ConvertToUTF16
//
//---------------------------------------------------------------
#if WIN
uint32 XMacRomanTranscoder::ConvertToUTF16(const char* src, uint32 srcBytes, wchar_t* dst, uint32 dstBytes)
{
	PRECONDITION(src != nil);
	PRECONDITION(dst != nil);
	
	uint32 uniBytes = 0;
	
	if (srcBytes > 0) {
		if (mHasMacCodePage)
			uniBytes = Inherited::ConvertToUTF16(src, srcBytes, dst, dstBytes);
			
		else {
			uint32 dstLen = dstBytes/2;
				
			uint32 index = 0;
			while (src[index] != '\0' && index < dstLen) {
				uint32 ch = src[index] & 0xFFUL;
				dst[index] = kMacToUnicode[ch];
				++index;
			}
			
			uniBytes = 2*index;
		}
	}
		
#if DEBUG
	if (msFlagToUTF16Conversions > 0) 
		DEBUGSTR("Converted char*: '", dst);
#endif

	return uniBytes;
}
#endif


//---------------------------------------------------------------
//
// XMacRomanTranscoder::GetDstBytes (char*, uint32)
//
//---------------------------------------------------------------
#if WIN
uint32 XMacRomanTranscoder::GetDstBytes(const char* src, uint32 srcBytes)
{	
	uint32 dstBytes = 0;
	
	if (!mUseOS || !mHasMacCodePage)
		dstBytes = 2*srcBytes;
	else 
		dstBytes = Inherited::GetDstBytes(src, srcBytes);

	return dstBytes;
}
#endif


//---------------------------------------------------------------
//
// XMacRomanTranscoder::ConvertFromUTF16
//
//---------------------------------------------------------------
#if WIN
uint32 XMacRomanTranscoder::ConvertFromUTF16(const wchar_t* src, uint32 srcBytes, char* dst, uint32 dstBytes)
{
	PRECONDITION(src != nil);
	PRECONDITION(dst != nil);
			
	uint32 charBytes = 0;	
	
	if (srcBytes > 0) {
		if (mHasMacCodePage)
			charBytes = Inherited::ConvertFromUTF16(src, srcBytes, dst, dstBytes);
			
		else {	
			// $$ This code won't work quite right if the Unicode uses 
			// $$ decomposed characters. It would be possible to use
			// $$ FoldString to get rid of the combining characters,
			// $$ except that FoldString isn't available on Win95...
			SCharCode code;
			uint32 index = 0;
			while (src[index] != '\0' && index < dstBytes) {
				code.unicode = src[index];
	
				const SCharCode* iter = std::lower_bound(kUnicodeToMac, kUnicodeToMac + 256, code);
				if (iter < kUnicodeToMac + 256) {
					dst[index] = (char) (iter->code);
				
				} else {					
					if (mFromUTF16Flags & MB_ERR_INVALID_CHARS)
						ThrowErr(ERROR_NO_UNICODE_TRANSLATION);
					else
						dst[index] = '?';
				}	
				
				++index;
			}
			
			charBytes = index;
		}
	}
		
	return charBytes;
}
#endif


//---------------------------------------------------------------
//
// XMacRomanTranscoder::GetDstBytes (wchar_t*, uint32)
//
//---------------------------------------------------------------
#if WIN
uint32 XMacRomanTranscoder::GetDstBytes(const wchar_t* src, uint32 srcBytes)
{
	uint32 dstBytes = 0;
	
	if (!mUseOS || !mHasMacCodePage)
		dstBytes = srcBytes/2;
	else 
		dstBytes = Inherited::GetDstBytes(src, srcBytes);

	return dstBytes;
}
#endif

#if __MWERKS__
#pragma mark -
#endif

// ===================================================================================
//	class XWindowsLatin1Transcoder
// ===================================================================================

//---------------------------------------------------------------
//
// XWindowsLatin1Transcoder::~XWindowsLatin1Transcoder
//
//---------------------------------------------------------------
XWindowsLatin1Transcoder::~XWindowsLatin1Transcoder()
{
}


//---------------------------------------------------------------
//
// XWindowsLatin1Transcoder::XWindowsLatin1Transcoder
//
//---------------------------------------------------------------
XWindowsLatin1Transcoder::XWindowsLatin1Transcoder(bool useDecomposedCharacters) : 
#if MAC
	XTextTranscoder(MyCreateTextEncoding(kTextEncodingWindowsLatin1, (uint32) (useDecomposedCharacters ? kUnicodeCanonicalDecompVariant : kTextEncodingDefaultVariant), kTextEncodingDefaultFormat), useDecomposedCharacters)
#elif WIN
	XTextTranscoder(CP_ACP, useDecomposedCharacters)
#endif
{
	mEncoding = L"iso-8859-1";
}


//---------------------------------------------------------------
//
// XWindowsLatin1Transcoder::Clone
//
//---------------------------------------------------------------
XWindowsLatin1Transcoder* XWindowsLatin1Transcoder::Clone() const
{
	return new XWindowsLatin1Transcoder;
}

#if __MWERKS__
#pragma mark -
#endif

// ===================================================================================
//	class XUTF8Transcoder
// ===================================================================================

//---------------------------------------------------------------
//
// XUTF8Transcoder::~XUTF8Transcoder
//
//---------------------------------------------------------------
XUTF8Transcoder::~XUTF8Transcoder()
{
#if MAC
	if (mTo16TEC != nil)
		VERIFY(::TECDisposeConverter(mTo16TEC) == noErr);
	
	if (mFrom16TEC != nil)
		VERIFY(::TECDisposeConverter(mFrom16TEC) == noErr);
#endif
}


//---------------------------------------------------------------
//
// XUTF8Transcoder::XUTF8Transcoder
//
//---------------------------------------------------------------
XUTF8Transcoder::XUTF8Transcoder() :	
#if MAC
	XTextTranscoder(MyCreateTextEncoding(kTextEncodingUS_ASCII, kTextEncodingDefaultVariant, kTextEncodingDefaultFormat))	// this encoding isn't used...
#elif WIN
	XTextTranscoder(CP_UTF8)
#endif
{
	mEncoding = L"iso-10646-utf-2";

#if MAC
	mTo16TEC = nil;
	mFrom16TEC = nil;

	mHasSystemSupport = MSystemInfo::GetTextEncodingConverterVersion() >= 0x121;
	mUseOS = mHasSystemSupport;

#elif WIN
	CPINFO info;
	int32 succeeded = ::GetCPInfo(CP_UTF8, &info);
	mHasSystemSupport = succeeded != 0;					// Win 95 doesn't support utf-8 conversions...
#endif
}


//---------------------------------------------------------------
//
// XUTF8Transcoder::Clone
//
//---------------------------------------------------------------
XUTF8Transcoder* XUTF8Transcoder::Clone() const
{
	return new XUTF8Transcoder;
}


//---------------------------------------------------------------
//
// XUTF8Transcoder::IsValidUTF8							[static]
//
//---------------------------------------------------------------
bool XUTF8Transcoder::IsValidUTF8(const char* src, uint32 numChars)
{
	PRECONDITION(src != nil);
	
	bool valid = true;

	uint32 index = 0;
	while (index < numChars && valid) {
		char ch = src[index];
		int32 count = 0;
		
		// 0xxxxxxx 
		if ((ch & 0x80) == 0)
			++index;

		// 11110uuu 10uuzzzz 10yyyyyy 10xxxxxx
		else if ((ch & 0xF8) == 0xF0) {
			++index;
			count = 3;
		
		// 1110zzzz 10yyyyyy 10xxxxxx
		} else if ((ch & 0xE0) == 0xE0) {
			++index;
			count = 2;
		
		// 110yyyyy 10xxxxxx
		} else if ((ch & 0xE0) == 0xC0) {
			++index;
			count = 1;
			
		} else
			valid = false;
			
		while (valid && count--) {
			if (index >= numChars)
				valid = false;
			
			else if ((src[index++] & 0xC0) != 0x80)		// 10uuzzzz
				valid = false;
		}
	}
	
	return valid;
}


//---------------------------------------------------------------
//
// XUTF8Transcoder::IsValidUTF16						[static]
//
//---------------------------------------------------------------
bool XUTF8Transcoder::IsValidUTF16(const wchar_t* src, uint32 numChars)
{
	PRECONDITION(src != nil);
	
	bool valid = true;
	uint32 index = 0;
	while (index < numChars && valid) {
		wchar_t ch = src[index++];
		
		if (ch >= 0xD800 && ch <= 0xDBFF) {			// high surrogate
			if (index >= numChars)
				valid = false;
			
			else {
				ch = src[index++];
				if (ch < 0xDC00 || ch > 0xDFFF)		// low surrogate expected
					valid = false;
			}
		
		} else if (ch >= 0xDC00 && ch <= 0xDFFF)	// misplaced low surrogate
			valid = false;
			
		else if (ch == 0xFFFD)						// replacement character
			valid = false;
			
		else
			valid = Whisper::IsValid(ch);
	}
		
	return valid;
}


//---------------------------------------------------------------
//
// XUTF8Transcoder::ConvertToUTF16
//
// The Unicode Converter doesn't support Unicode to Unicode
// conversions so we have to fall back on the Text Encoding
// Converter. (It'd be simpler to use TEC for everything, but
// the Unicode Converter offers more control over how the
// conversion is performed via the flags argument).
//
//---------------------------------------------------------------
uint32 XUTF8Transcoder::ConvertToUTF16(const char* src, uint32 srcBytes, wchar_t* dst, uint32 dstBytes)
{
	PRECONDITION(src != nil);
	PRECONDITION(dst != nil);
	
	uint32 uniBytes = 0;

#if MAC
	bool rejectInvalid = (mToUTF16Flags & kUnicodeUseFallbacksMask) == 0;
#elif WIN
	bool rejectInvalid = (mToUTF16Flags & MB_ERR_INVALID_CHARS) == MB_ERR_INVALID_CHARS;
#endif
	if (rejectInvalid)
		if (!XUTF8Transcoder::IsValidUTF8(src, srcBytes))	// TEC won't do this for us
			ThrowErr(kNoTranslation);						// MultiByteToWideChar should do this, but I get a bad flags error when I use MB_ERR_INVALID_CHARS
				
	if (mHasSystemSupport && mUseOS && srcBytes > 0) {
#if MAC
		if (mTo16TEC == nil) {
			uint32 encoding16 = CreateTextEncoding(kTextEncodingUnicodeDefault, kTextEncodingDefaultVariant, kUnicode16BitFormat);
			uint32 encoding8  = CreateTextEncoding(kTextEncodingUnicodeDefault, kTextEncodingDefaultVariant, kUnicodeUTF8Format);
	
			OSStatus err = ::TECCreateConverter(&mTo16TEC, encoding8, encoding16);
			ThrowIfOSErr(err);
		}
				
		OSStatus err = ::TECClearConverterContextInfo(mTo16TEC);
		ThrowIfOSErr(err);

		uint32 bytesConverted = 0;
		err = ::TECConvertText(mTo16TEC, 			// the text converter object
							   (ConstTextPtr) src, 	// the input stream
							   srcBytes, 			// byte length of input stream
							   &bytesConverted, 	// number of input bytes that were translated
							   (TextPtr) dst, 		// output buffer
							   dstBytes, 			// byte length of output buffer
							   &uniBytes);			// byte length of converted chars
	
		if (err != noErr && err != kTECUsedFallbacksStatus)
			ThrowErr(err);
		ASSERT(bytesConverted == srcBytes);

#elif WIN			
		// $$$ NT 4 and Win98 don't properly handle surrogate characters (they
		// $$$ get mapped to 0x0000 and the fallback character 0xFFFD). 
		uniBytes = Inherited::ConvertToUTF16(src, srcBytes, dst, dstBytes);
#endif

	} else if (srcBytes > 0) {
		UTF8* source = (UTF8*) src;
		UTF16* target = (UTF16*) dst;
		
		ConversionResult result = ConvertUTF8toUTF16(&source, source + srcBytes, &target, target + dstBytes/2);
		if (result == sourceExhausted)
			ThrowErr(kPartialConversion);
		else if (result == targetExhausted)
			ThrowErr(kBufferExhausted);
			
		uniBytes = 2UL*(target - (UTF16*) dst);
	}
	
	if (rejectInvalid)  
		if (!XUTF8Transcoder::IsValidUTF16(dst, uniBytes/2))
			ThrowErr(kNoTranslation);

	return uniBytes;
}


//---------------------------------------------------------------
//
// XUTF8Transcoder::GetDstBytes (char*, uint32)
//
//---------------------------------------------------------------
uint32 XUTF8Transcoder::GetDstBytes(const char* src, uint32 srcBytes)
{	
	uint32 dstBytes = 0;
	
	if (mUseOS && mHasSystemSupport)
		dstBytes = Inherited::GetDstBytes(src, srcBytes);
	else 
		dstBytes = 2*srcBytes;

	return dstBytes;
}


//---------------------------------------------------------------
//
// XUTF8Transcoder::ConvertFromUTF16
//
//---------------------------------------------------------------
uint32 XUTF8Transcoder::ConvertFromUTF16(const wchar_t* src, uint32 srcBytes, char* dst, uint32 dstBytes)
{
	PRECONDITION(src != nil);
	PRECONDITION(dst != nil);
			
	uint32 charBytes = 0;	
	
#if MAC
	bool rejectInvalid = (mFromUTF16Flags & kUnicodeUseFallbacksMask) == 0;
#elif WIN
	bool rejectInvalid = !mHasSystemSupport || !mUseOS;
#endif
	if (rejectInvalid)
		if (!XUTF8Transcoder::IsValidUTF16(src, srcBytes/2))	// TEC won't do this for us
			ThrowErr(kNoTranslation);							
				
	if (mHasSystemSupport && mUseOS && srcBytes > 0) {
#if MAC
		if (mFrom16TEC == nil) {						// transcoder objects are cloned when copying strings so we'll defer the heavy lifting until as late as possible
			uint32 encoding16 = CreateTextEncoding(kTextEncodingUnicodeDefault, kTextEncodingDefaultVariant, kUnicode16BitFormat);
			uint32 encoding8  = CreateTextEncoding(kTextEncodingUnicodeDefault, kTextEncodingDefaultVariant, kUnicodeUTF8Format);
		
			OSStatus err = ::TECCreateConverter(&mFrom16TEC, encoding16, encoding8);
			ThrowIfOSErr(err);
		} 
			
		OSStatus err = ::TECClearConverterContextInfo(mFrom16TEC);
		ThrowIfOSErr(err);

		uint32 bytesConverted = 0;
		err = ::TECConvertText(mFrom16TEC, 			// the text converter object
							   (ConstTextPtr) src, 	// the input stream
							   srcBytes, 			// byte length of input stream
							   &bytesConverted, 	// number of input bytes that were translated
							   (TextPtr) dst, 		// output buffer
							   dstBytes, 			// byte length of output buffer
							   &charBytes);			// byte length of converted chars
	
		if (err != noErr && err != kTECUsedFallbacksStatus)
			ThrowErr(err);
		ASSERT(bytesConverted == srcBytes);

			
#elif WIN 
		charBytes = Inherited::ConvertFromUTF16(src, srcBytes, dst, dstBytes);
#endif

	} else if (srcBytes > 0) {
		UTF16* source = (UTF16*) src;
		UTF8* target = (UTF8*) dst;
		
		ConversionResult result = ConvertUTF16toUTF8(&source, source + srcBytes/2, &target, target + dstBytes);
		if (result == sourceExhausted)
			ThrowErr(kPartialConversion);
		else if (result == targetExhausted)
			ThrowErr(kBufferExhausted);
			
		charBytes = numeric_cast<uint32>(target - (UTF8*) dst);
	}
		
	return charBytes;
}


//---------------------------------------------------------------
//
// XUTF8Transcoder::GetDstBytes (wchar_t*, uint32)
//
//---------------------------------------------------------------
uint32 XUTF8Transcoder::GetDstBytes(const wchar_t* src, uint32 srcBytes)
{
	uint32 dstBytes = 0;
	
	if (mUseOS && mHasSystemSupport)
		dstBytes = Inherited::GetDstBytes(src, srcBytes);
	else 
		dstBytes = 2*srcBytes;		// worst case: each utf-16 character is 4 utf-8 bytes

	return dstBytes;
}

#if __MWERKS__
#pragma mark -
#endif

// ===================================================================================
//	class XEUCJPTranscoder
// ===================================================================================

#if MAC
//---------------------------------------------------------------
//
// XEUCJPTranscoder::~XEUCJPTranscoder
//
//---------------------------------------------------------------
XEUCJPTranscoder::~XEUCJPTranscoder()
{
}


//---------------------------------------------------------------
//
// XEUCJPTranscoder::XEUCJPTranscoder
//
//---------------------------------------------------------------
XEUCJPTranscoder::XEUCJPTranscoder(bool useDecomposedCharacters) : 
	XTextTranscoder(MyCreateTextEncoding(kTextEncodingEUC_JP, (uint32) (useDecomposedCharacters ? kUnicodeCanonicalDecompVariant : kTextEncodingDefaultVariant), kTextEncodingDefaultFormat), useDecomposedCharacters)
{
	mEncoding = L"iso-646";
}


//---------------------------------------------------------------
//
// XEUCJPTranscoder::Clone
//
//---------------------------------------------------------------
XEUCJPTranscoder* XEUCJPTranscoder::Clone() const
{
	return new XEUCJPTranscoder;
}
#endif	// MAC

#if __MWERKS__
#pragma mark -
#endif

// ===================================================================================
//	class XShiftJISTranscoder
// ===================================================================================

#if MAC
//---------------------------------------------------------------
//
// XShiftJISTranscoder::~XShiftJISTranscoder
//
//---------------------------------------------------------------
XShiftJISTranscoder::~XShiftJISTranscoder()
{
}


//---------------------------------------------------------------
//
// XShiftJISTranscoder::XShiftJISTranscoder
//
//---------------------------------------------------------------
XShiftJISTranscoder::XShiftJISTranscoder(bool useDecomposedCharacters) : 
	XTextTranscoder(MyCreateTextEncoding(kTextEncodingShiftJIS, (uint32) (useDecomposedCharacters ? kUnicodeCanonicalDecompVariant : kTextEncodingDefaultVariant), kTextEncodingDefaultFormat), useDecomposedCharacters)
{
	mEncoding = L"shift-jis";
}


//---------------------------------------------------------------
//
// XShiftJISTranscoder::Clone
//
//---------------------------------------------------------------
XShiftJISTranscoder* XShiftJISTranscoder::Clone() const
{
	return new XShiftJISTranscoder;
}
#endif	// MAC


}	// namespace Whisper
